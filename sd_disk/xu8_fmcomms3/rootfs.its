## sd_disk/xu8_fmcomms3/rootfs.its
```
/dts-v1/;

/ {
    description = "Kernel fitImage for XU8-zynqmp";
    #address-cells = <1>;

    images {
        kernel-1 {
            description = "Linux kernel";
            data = /incbin/("./build/Image.gz");
            type = "kernel";
            arch = "arm64";
            os = "linux";
            compression = "gzip";
            load  = <0x200000>; // <0x80000>
            entry = <0x200000>; // <0x80000>
            hash-1 {
                algo = "sha256";
            };
        };
        fdt-1 {
            description = "Flattened Device Tree blob";
            data = /incbin/("./build/system.dtb");
            type = "flat_dt";
            arch = "arm64";
            compression = "none";
            hash-1 {
                algo = "sha256";
            };
        };
    };

    configurations {
        default = "conf-1";
        conf-1 {
            description = "Boot Linux kernel, FDT blob";
            kernel = "kernel-1";
            fdt = "fdt-1";
            hash-1 {
                algo = "sha256";
            };
        };
    };
};
```
